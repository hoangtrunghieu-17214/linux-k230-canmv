## Documentation/devicetree/bindings/clock/canaan,k230-clk.yaml
```yaml
# SPDX-License-Identifier: (GPL-2.0-only OR BSD-2-Clause)
%YAML 1.2
---
$id: http://devicetree.org/schemas/clock/canaan,k230-clk.yaml#
$schema: http://devicetree.org/meta-schemas/core.yaml#

title: Canaan Kendryte K230 Clock

maintainers:
  - Hoang Trung Hieu <hoangtrunghieu.gch17214@gmail.com>

description: |
  Bindings for the clock management unit of Canaan K230-CanMV SoC.
  The unit node must be defined as a child of the K230
  system controller node.

  See also:
  - dt-bindings/clock/k230-clk.h

properties:
  compatible:
    const: canaan,k230-clk

  clocks:
    maxItems: 1
    description:
      Phandle of a 24MHz fixed-rate oscillator clock.

  clock-names:
    items:
      - const: osc24m

  '#clock-cells':
    const: 1

  reg:
    maxItems: 2

  reg-names:
    items:
      - const: sys
      - const: pll

required:
  - compatible
  - '#clock-cells'
  - clocks
  - reg
  - reg-names

additionalProperties: false

examples:
  - |
    #include <dt-bindings/clock/canaan,k230-clk.h>
    clocks {
      osc24m: osc24m {
        #clock-cells = <0>;
        compatible = "fixed-clock";
        clock-frequency = <24000000>;
        clock-accuracy = <0>;
        status = "okay";
      };
    };

    /* ... */
    sysctl {
      status					= "okay";
      #address-cells 			= <2>;
      #size-cells 			    = <2>;
      compatible 				= "simple-bus";
      ranges;
    
      cmu: clock_controller@91100000 {
        status              = "okay";
        compatible 			= "canaan,k230-clk";
        reg                 = <0x0 0x91100000 0x0 0x1000>, <0x0 0x91102000 0x0 0x1000>;
        reg-names			= "sys", "pll";
        clocks				= <&osc24m>;
        clock-names			= "osc24m";
        #clock-cells		= <1>;
      };
    };
```

## drivers/clk/canaan/Kconfig
```kconfig
# SPDX-License-Identifier: GPL-2.0-only

menuconfig K230_COMMON_CLK
    bool "Canaan Kendryte K230 Clock support"
    depends on OF
    depends on ARCH_CANAAN || COMPILE_TEST
    depends on COMMON_CLK
    depends on HAS_IOMEM
    default ARCH_CANAAN
    help
      Support for the Canaan Kendryte K230 RISC-V SoC clocks.
```
